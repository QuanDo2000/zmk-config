## boards/shields/nova/Kconfig.defconfig
```kconfig
if SHIELD_NOVA_LEFT

config ZMK_KEYBOARD_NAME
    default "Nova"

config ZMK_SPLIT_ROLE_CENTRAL
    default y

endif

if SHIELD_NOVA_LEFT || SHIELD_NOVA_RIGHT

config ZMK_SPLIT
    default y

endif
```

## boards/shields/nova/Kconfig.shield
```kconfig
config SHIELD_NOVA_LEFT
    def_bool $(shields_list_contains,nova_left)

config SHIELD_NOVA_RIGHT
    def_bool $(shields_list_contains,nova_right)
```
